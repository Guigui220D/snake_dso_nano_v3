/*
 * drawing.c
 *
 *  Created on: 13 juin 2022
 *      Author: Guillaume
 */

#include "drawing.h"
#include "screen.h"

#define BGCOL1 0b0000001111100000
#define BGCOL2 0b0000011000000000
#define MENUCOL 0b0000000000001111

const unsigned short game_over_colors[] = {
		0x703f,
		0xffff,
		0x07ff
};

// RLE compressed
// 8 bits be like:
// 6 bits count (add + 1 for actual count), 2 bits pixel
const unsigned char game_over_sprite[2180] = {
		0xfc,0xfc,0xfc,0xfc,0xfc,0xfc,0xfc,0xfc,0xfc,0xfc,
		0xfc,0xfc,0xfc,0xfc,0xfc,0xfc,0xfc,0xfc,0xfc,0xfc,
		0xfc,0xfc,0xfc,0xfc,0xfc,0xfc,0xfc,0x98,0x21,0xfc,
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		0xfc,0xfc,0xfc,0xfc,0xfc,0xfc,0xfc,0xfc,0xfc,0xe0,
};

const unsigned char font[7680] = {
        0x00,0xfe,0x82,0x82,0x82,0x82,0x82,0x82,0x82,0xfe, // err
         0x00,0x00,0x00,0x00,0x00,0x00,0x00,0x00,0x00,0x00, // ' '
         0x00,0x78,0x78,0x78,0x30,0x30,0x30,0x00,0x30,0x30, // '!'
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         0x00,0x00,0x00,0x00,0x60,0xf2,0x9e,0x0c,0x00,0x00, // '~'

};

void draw_background() {
	screen_reset_window();
	screen_start_drawing();
	for (int i = 0; i < 320; i++) {
		for (int j = 0; j < 240; j++) {
			if ((j & 8) != ((i & 32) >> 2)) {
				screen_param(BGCOL1);
			} else {
				screen_param(BGCOL2);
			}

		}
	}
	screen_command(0);
}

void redraw_bg(unsigned short x1, unsigned short y1, unsigned short x2, unsigned short y2) {
	screen_set_window(x1, y1, x2, y2);
	screen_start_drawing();
	for (unsigned short y = y1; y <= y2; y++) {
		for (unsigned short x = x1; x <= x2; x++) {
			if ((x & 8) != ((y & 32) >> 2)) {
				screen_param(BGCOL1);
			} else {
				screen_param(BGCOL2);
			}
		}
	}
}

void draw_menu(int selected) {
	screen_set_window(42, 42, 197, 277);
	screen_start_drawing();

	for (int i = 0; i < 2180; i++) {
		unsigned char data = game_over_sprite[i];
		GPIOE->ODR = game_over_colors[data & 0b11];
		unsigned short count = 1 + (data >> 2);
		for (unsigned short j = 0; j < count; j++) {
			GPIOD->BSRR = GPIOD->BRR = sWR__Pin;
		}
	}
}

void erase_menu() {
	redraw_bg(40, 40, 199, 279);
}

void draw_char(unsigned short x, unsigned short y, char c) {
	screen_set_window(x, y, x + 7, y + 10);
	if (c < 32 || c >= 127)
		c = 31;
	const unsigned char * ch = font + (10 * (c - 31));
	screen_start_drawing();
	for (int i = 0; i < 10; i++) {
		char data = ch[i];
		for (int j = 0; j < 8; j++) {
			char c = data & 1;
			data >>= 1;
			screen_param(c ? 0x07ff : 0x703f);
		}
	}
}

void draw_string(unsigned short x, unsigned short y, const char * str){
	for (;*str;str++) {
		draw_char(232 - x, y, *str);
		x += 8;
	}
}

void draw_score(unsigned int i) {
	unsigned short x = 3;
	while (i > 0) {
		unsigned int next = i / 10;
		draw_char(x, 3, '0' + (i - next * 10));
		i = next;
		x += 8;
	}
}

void draw_header() {
	screen_set_window(0, 0, 239, 15);
	screen_start_drawing();
	GPIOE->ODR = 0x703f;
	for (int i = 0; i < 240 * 16; i++) {
		GPIOD->BSRR = GPIOD->BRR = sWR__Pin;
	}
	draw_string(3, 3, "Snake on your scope!");
}
